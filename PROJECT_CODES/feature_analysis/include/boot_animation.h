// ============================================================
//  INDUSTRIAL DOCTOR v2.0 — BOOT ANIMATION
//  Place in: include/boot_animation.h
//
//  #include "boot_animation.h"  ← keep at top with other includes
//
//  In setup(), after oled_init():
//    oled_boot_animation(display, oled_ready);  ← updated call
// ============================================================

#pragma once
#include <Adafruit_SSD1306.h>

// ============================================================
//  LOGO BITMAP  128×64  1-bit  MSB-first
//  Generated from your actual logo PNG (white + blue → ON)
// ============================================================
static const unsigned char PROGMEM logo_bmp[] = {
  0x3F, 0xE0, 0x00, 0x00, 0x00, 0x00, 0x00, 0x00, 0xFF, 0x80, 0x00, 0x00, 0x00, 0x00, 0x00, 0x00,  // 00
  0x7F, 0xE0, 0x00, 0x00, 0x00, 0x00, 0x00, 0x00, 0xFE, 0xC0, 0x00, 0x00, 0x00, 0x00, 0x00, 0x00,  // 01
  0x40, 0x00, 0x00, 0x00, 0x00, 0x00, 0x00, 0x00, 0x00, 0x40, 0x00, 0x00, 0x00, 0x00, 0x00, 0x00,  // 02
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  0x00, 0x00, 0x00, 0x00, 0x00, 0x00, 0x00, 0x00, 0x00, 0x00, 0x00, 0x00, 0x00, 0x00, 0x00, 0x00,  // 63
};

// ============================================================
//  HELPER — draws logo at optional pixel offset
// ============================================================
static void _draw_logo(Adafruit_SSD1306 &d, int8_t dx = 0, int8_t dy = 0)
{
    d.drawBitmap(dx, dy, logo_bmp, 128, 64, SSD1306_WHITE);
}

// ============================================================
//  BOOT ANIMATION  (~4 s total)
//
//  CALL:  oled_boot_animation(display, oled_ready);
// ============================================================
static void oled_boot_animation(Adafruit_SSD1306 &d, bool ready)
{
    if (!ready) return;

    // ── Phase 1 : Pixel Storm ────────────────────────────────
    for (int f = 0; f < 22; f++) {
        d.clearDisplay();
        int n = map(f, 0, 21, 15, 240);
        for (int i = 0; i < n; i++)
            d.drawPixel(random(128), random(64), SSD1306_WHITE);
        d.display();
        delay(20);
    }

    // ── Phase 2 : Scanline Wipe (top → bottom) ───────────────
    for (int y = 0; y < 64; y += 2) {
        d.clearDisplay();
        d.drawFastHLine(0, y,     128, SSD1306_WHITE);
        d.drawFastHLine(0, y + 1, 128, SSD1306_WHITE);
        int noise = map(y, 0, 62, 60, 8);
        for (int i = 0; i < noise; i++)
            d.drawPixel(random(128), random(y + 2, 64), SSD1306_WHITE);
        d.display();
        delay(9);
    }
    d.clearDisplay();
    d.display();
    delay(40);

    // ── Phase 3 : Logo Flicker / Glitch Reveal ───────────────
    for (int g = 0; g < 10; g++) {
        d.clearDisplay();

        if (g == 1 || g == 4) {       // strobe blank frames
            d.display();
            delay(35);
            continue;
        }

        int    mag = (g < 3) ? 6 : (g < 6) ? 3 : (g < 8) ? 1 : 0;
        int8_t dx  = (mag > 0) ? (int8_t)random(-mag, mag + 1) : 0;
        int8_t dy  = (mag > 0) ? (int8_t)random(-mag / 2, mag / 2 + 1) : 0;

        _draw_logo(d, dx, dy);

        int bars = max(0, 5 - g);
        for (int b = 0; b < bars; b++) {
            int gy = random(4, 60);
            int gw = random(12, 80);
            int gx = random(0, 128 - gw);
            for (int px = gx; px < gx + gw; px++)
                d.drawPixel(px, gy, SSD1306_WHITE);
        }

        if (g < 5 && random(2)) {
            int tx = random(10, 118);
            d.drawFastVLine(tx + 1, random(0, 30), random(10, 34), SSD1306_WHITE);
        }

        d.display();
        delay(55);
    }

    // ── Phase 4 : Logo Locks On (3 rapid blinks) ─────────────
    for (int b = 0; b < 3; b++) {
        d.clearDisplay(); d.display();       delay(40);
        d.clearDisplay(); _draw_logo(d);     d.display(); delay(80);
    }
    d.clearDisplay();
    _draw_logo(d);
    d.display();
    delay(500);

    // ── Phase 5 : EKG Heartbeat ──────────────────────────────
    static const int8_t EKG[32] = {
         0,  0,  0,  0,  0,  0,  0,  0,
        -2, -3, -2,  0,
       -10,-16,  8,  6,  3,  1,  0,
         0,  0,  0,  0,  0,  0,  0,  0,  0,  0,  0,  0,  0
    };
    const int EKG_Y = 60;

    for (int sweep = 0; sweep < 3; sweep++) {
        for (int offset = 0; offset < 32; offset += 2) {
            d.clearDisplay();
            _draw_logo(d);
            for (int x = 0; x < 128; x++) {
                int y = constrain(EKG_Y + EKG[(x + offset) & 31], 0, 63);
                d.drawPixel(x, y, SSD1306_WHITE);
                if (y + 1 < 64) d.drawPixel(x, y + 1, SSD1306_WHITE);
            }
            d.display();
            delay(16);
        }
    }

    // ── Phase 6 : SYSTEM ONLINE Flash ────────────────────────
    for (int b = 0; b < 6; b++) {
        d.clearDisplay();
        _draw_logo(d);
        if (b % 2 == 0) {
            d.fillRect(0, 57, 128, 7, SSD1306_WHITE);
            d.setTextColor(SSD1306_BLACK);
            d.setTextSize(1);
            d.setCursor(4, 58);
            d.print("[ SYSTEM  ONLINE ]");
            d.setTextColor(SSD1306_WHITE);
        }
        d.display();
        delay(150);
    }

    // ── Final hold frame ─────────────────────────────────────
    d.clearDisplay();
    _draw_logo(d);
    d.fillRect(0, 57, 128, 7, SSD1306_WHITE);
    d.setTextColor(SSD1306_BLACK);
    d.setTextSize(1);
    d.setCursor(4, 58);
    d.print("[ SYSTEM  ONLINE ]");
    d.setTextColor(SSD1306_WHITE);
    d.display();
    delay(700);
}